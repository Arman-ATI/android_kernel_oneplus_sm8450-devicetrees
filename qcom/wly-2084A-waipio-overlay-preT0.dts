/dts-v1/;
/plugin/;

#include "waipio-mtp.dtsi"
#include "waipio-pm8010-spmi.dtsi"
#include <dt-bindings/oplus/hw-id.h>

#include "oplus/waipio_overlay_common.dtsi"
#include "oplus/wly_20846_overlay_common.dtsi"
#include "oplus/oplus_chg/oplus-chg-2084A-preT0.dtsi"
#include "oplus/nfc/wly-nfc-sn100t.dtsi"
#include "oplus/sensor/wly-oplus-sensor.dtsi"

#include "audio/waipio-audio-mtp.dtsi"
#include "audio/oplus/waipio_audio_overlay_common.dtsi"
#include "audio/oplus/wly_20846_audio_overlay_common.dtsi"

#include "camera/oplus/wly_20846_camera_overlay_common-preT0.dtsi"

#include "display/display/waipio-sde-display-mtp.dtsi"
#include "display/oplus/waipio_display_overlay_common.dtsi"
#include "display/oplus/wly_20846_display_overlay_common.dtsi"

/ {
    model = "Qualcomm Technologies, Inc. Waipio MTP with PM8010, WLY";
    compatible = "qcom,waipio-mtp", "qcom,waipio", "qcom,mtp", "qcom,sm8450";
    qcom,msm-id = <457 0x10000>, <482 0x10000>, <457 0x20000>, <482 0x20000>, <552 0x10000>;
    qcom,board-id = <0x10008 0>, <0x03010008 0x03>;

    oplus,project-id = <0x2084a>;
    oplus,hw-id = <OPLUS_EVB1>;
};
